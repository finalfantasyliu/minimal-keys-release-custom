## config/west.yml
```yaml
manifest:
  remotes:
    - name: zmkfirmware
      url-base: https://github.com/zmkfirmware
    - name: hyhy-masa
      url-base: https://github.com/hyhy-masa
    - name: caksoylar  # <-- new entry
      url-base: https://github.com/caksoylar  
  projects:
    - name: zmk
      remote: zmkfirmware
      revision: main
      import: app/west.yml
    # zmk-pmw3610-driver 已移除：Zephyr 4.1 内建 PMW3610 驅動
    - name: zmk-rgbled-widget
      remote: caksoylar
      revision: main
  self:
    path: config
```
